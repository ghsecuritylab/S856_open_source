/* Copyright (c) 2013, The Linux Foundation. All rights reserved.
 *
 * This program is free software; you can redistribute it and/or modify
 * it under the terms of the GNU General Public License version 2 and
 * only version 2 as published by the Free Software Foundation.
 *
 * This program is distributed in the hope that it will be useful,
 * but WITHOUT ANY WARRANTY; without even the implied warranty of
 * MERCHANTABILITY or FITNESS FOR A PARTICULAR PURPOSE.  See the
 * GNU General Public License for more details.
 */

/*---------------------------------------------------------------------------
 * This file is autogenerated file using gcdb parser. Please do not edit it.
 * Update input XML file to add a new entry or update variable in this file
 * VERSION = "1.0"
 *---------------------------------------------------------------------------*/
&mdss_mdp {
	dsi_nt35521_tianma_720_vid: qcom,mdss_dsi_nt35521_tianma_720p_video {
		qcom,mdss-dsi-panel-name = "NT35521 tianma_720p video mode dsi panel";
		qcom,mdss-dsi-panel-controller = <&mdss_dsi0>;
		qcom,mdss-dsi-panel-type = "dsi_video_mode";
		qcom,mdss-dsi-panel-destination = "display_1";
		qcom,mdss-dsi-panel-framerate = <60>;
		qcom,mdss-dsi-virtual-channel-id = <0>;
		qcom,mdss-dsi-stream = <0>;
		qcom,mdss-dsi-panel-width = <720>;
		qcom,mdss-dsi-panel-height = <1280>;
		qcom,mdss-dsi-h-front-porch = <200>;
		qcom,mdss-dsi-h-back-porch = <200>;
		qcom,mdss-dsi-h-pulse-width = <16>;
		qcom,mdss-dsi-h-sync-skew = <0>;
		qcom,mdss-dsi-v-back-porch = <20>;
		qcom,mdss-dsi-v-front-porch = <20>;
		qcom,mdss-dsi-v-pulse-width = <2>;
		qcom,mdss-dsi-h-left-border = <0>;
		qcom,mdss-dsi-h-right-border = <0>;
		qcom,mdss-dsi-v-top-border = <0>;
		qcom,mdss-dsi-v-bottom-border = <0>;
		qcom,mdss-dsi-bpp = <24>;
		qcom,mdss-dsi-color-order = "rgb_swap_rgb";
		qcom,mdss-dsi-underflow-color = <0xff>;
		qcom,mdss-dsi-border-color = <0>;
		qcom,cont-splash-enabled;
		qcom,mdss-dsi-pixel-packing = "tight";
		qcom,mdss-dsi-on-command = [
			39 01 00 00 00 00 05 FF AA 55 A5 80
			39 01 00 00 00 00 03 6F 11 00
			39 01 00 00 00 00 03 F7 20 00
			39 01 00 00 00 00 02 6F 11   
			39 01 00 00 00 00 02 F3 01
			39 01 00 00 00 00 06 F0 55 AA 52 08 00 
			39 01 00 00 00 00 06 BD 01 A0 0C 08 01 
			39 01 00 00 00 00 02 6F 02   
			39 01 00 00 00 00 02 B8 0C
			39 01 00 00 00 00 03 BB 11 11          
			39 01 00 00 00 00 03 BC 00 00          
			39 01 00 00 00 00 02 B6 01             
			39 01 00 00 00 00 03 D9 03 05
			39 01 00 00 00 00 06 F0 55 AA 52 08 01
			39 01 00 00 00 00 03 B0 09 09         
			39 01 00 00 00 00 03 B1 09 09         
			39 01 00 00 00 00 03 BC 78 00         
			39 01 00 00 00 00 03 BD 78 00         
			39 01 00 00 00 00 02 CA 00            
			39 01 00 00 00 00 02 C0 04            
			39 01 00 00 00 00 03 B5 03 03         
			39 01 00 00 00 00 02 BE 5B            
			39 01 00 00 00 00 03 B3 28 28                                                                 
			39 01 00 00 00 00 03 B4 0F 0F                                                                 
			39 01 00 00 00 00 03 B9 34 34                                                                 
			39 01 00 00 00 00 03 BA 15 15                                                                 
			39 01 00 00 00 00 06 F0 55 AA 52 08 02                                    
			39 01 00 00 00 00 02 6F 02   
			39 01 00 00 00 00 02 F7 47   
			39 01 00 00 00 00 02 6F 0A   
			39 01 00 00 00 00 02 F7 02   
			39 01 00 00 00 00 02 6F 17   
			39 01 00 00 00 00 02 F4 70   
			39 01 00 00 00 00 02 6F 11   
			39 01 00 00 00 00 02 F3 01
			39 01 00 00 00 00 06 F0 55 AA 52 08 06
			39 01 00 00 00 00 03 B0 12 10         
			39 01 00 00 00 00 03 B1 18 16         
			39 01 00 00 00 00 03 B2 00 02         
			39 01 00 00 00 00 03 B3 31 31         
			39 01 00 00 00 00 03 B4 31 31         
			39 01 00 00 00 00 03 B5 31 31         
			39 01 00 00 00 00 03 B6 31 31         
			39 01 00 00 00 00 03 B7 31 31         
			39 01 00 00 00 00 03 B8 31 08         
			39 01 00 00 00 00 03 B9 2E 2D         
			39 01 00 00 00 00 03 BA 2D 2E         
			39 01 00 00 00 00 03 BB 09 31         
			39 01 00 00 00 00 03 BC 31 31         
			39 01 00 00 00 00 03 BD 31 31         
			39 01 00 00 00 00 03 BE 31 31         
			39 01 00 00 00 00 03 BF 31 31         
			39 01 00 00 00 00 03 C0 31 31         
			39 01 00 00 00 00 03 C1 03 01         
			39 01 00 00 00 00 03 C2 17 19         
			39 01 00 00 00 00 03 C3 11 13         
			39 01 00 00 00 00 03 E5 31 31         
			39 01 00 00 00 00 03 C4 17 19         
			39 01 00 00 00 00 03 C5 11 13         
			39 01 00 00 00 00 03 C6 03 01         
			39 01 00 00 00 00 03 C7 31 31         
			39 01 00 00 00 00 03 C8 31 31         
			39 01 00 00 00 00 03 C9 31 31         
			39 01 00 00 00 00 03 CA 31 31         
			39 01 00 00 00 00 03 CB 31 31         
			39 01 00 00 00 00 03 CC 31 09         
			39 01 00 00 00 00 03 CD 2D 2E         
			39 01 00 00 00 00 03 CE 2E 2D         
			39 01 00 00 00 00 03 CF 08 31         
			39 01 00 00 00 00 03 D0 31 31         
			39 01 00 00 00 00 03 D1 31 31         
			39 01 00 00 00 00 03 D2 31 31         
			39 01 00 00 00 00 03 D3 31 31         
			39 01 00 00 00 00 03 D4 31 31         
			39 01 00 00 00 00 03 D5 00 02         
			39 01 00 00 00 00 03 D6 12 10         
			39 01 00 00 00 00 03 D7 18 16                 
			39 01 00 00 00 00 06 D8 00 00 00 00 00
			39 01 00 00 00 00 06 D9 00 00 00 00 00
			39 01 00 00 00 00 02 E7 00            
			39 01 00 00 00 00 06 F0 55 AA 52 08 05
			39 01 00 00 00 00 02 ED 30            
			39 01 00 00 00 00 06 F0 55 AA 52 08 03
			39 01 00 00 00 00 03 B1 00 00         
			39 01 00 00 00 00 03 B0 20 00         
			39 01 00 00 00 00 06 F0 55 AA 52 08 05
			39 01 00 00 00 00 02 E5 00
			39 01 00 00 00 00 06 F0 55 AA 52 08 05
			39 01 00 00 00 00 03 B0 17 06         
			39 01 00 00 00 00 02 B8 00            
			39 01 00 00 00 00 06 BD 03 03 01 00 03
			39 01 00 00 00 00 03 B1 17 06         
			39 01 00 00 00 00 03 B9 00 03         
			39 01 00 00 00 00 03 B2 17 06         
			39 01 00 00 00 00 03 BA 00 00         
			39 01 00 00 00 00 03 B3 17 06         
			39 01 00 00 00 00 03 BB 00 00         
			39 01 00 00 00 00 03 B4 17 06         
			39 01 00 00 00 00 03 B5 17 06         
			39 01 00 00 00 00 03 B6 17 06         
			39 01 00 00 00 00 03 B7 17 06         
			39 01 00 00 00 00 03 BC 00 03         
			39 01 00 00 00 00 02 E5 06            
			39 01 00 00 00 00 02 E6 06            
			39 01 00 00 00 00 02 E7 06            
			39 01 00 00 00 00 02 E8 06            
			39 01 00 00 00 00 02 E9 06            
			39 01 00 00 00 00 02 EA 06            
			39 01 00 00 00 00 02 EB 06            
			39 01 00 00 00 00 02 EC 06            
			39 01 00 00 00 00 06 F0 55 AA 52 08 05
			39 01 00 00 00 00 02 C0 0B            
			39 01 00 00 00 00 02 C1 09            
			39 01 00 00 00 00 02 C2 0B            
			39 01 00 00 00 00 02 C3 09            
			39 01 00 00 00 00 06 F0 55 AA 52 08 03
			39 01 00 00 00 00 06 B2 05 00 00 00 90
			39 01 00 00 00 00 06 B3 05 00 00 00 90
			39 01 00 00 00 00 06 B4 05 00 00 00 90
			39 01 00 00 00 00 06 B5 05 00 00 00 90
			39 01 00 00 00 00 06 F0 55 AA 52 08 05
			39 01 00 00 00 00 02 C4 10            
			39 01 00 00 00 00 02 C5 10            
			39 01 00 00 00 00 02 C6 10            
			39 01 00 00 00 00 02 C7 10            
			39 01 00 00 00 00 06 F0 55 AA 52 08 03
			39 01 00 00 00 00 06 B6 05 00 00 00 90
			39 01 00 00 00 00 06 B7 05 00 00 00 90
			39 01 00 00 00 00 06 B8 05 00 00 00 90
			39 01 00 00 00 00 06 B9 05 00 00 00 90
			39 01 00 00 00 00 06 F0 55 AA 52 08 05
			39 01 00 00 00 00 03 C8 07 20         
			39 01 00 00 00 00 03 C9 03 20         
			39 01 00 00 00 00 03 CA 07 00         
			39 01 00 00 00 00 03 CB 03 00         
			39 01 00 00 00 00 06 F0 55 AA 52 08 03
			39 01 00 00 00 00 06 BA 44 00 00 01 00
			39 01 00 00 00 00 06 BB 44 00 00 01 00
			39 01 00 00 00 00 06 BC 44 00 00 01 00
			39 01 00 00 00 00 06 BD 44 00 00 01 00
			39 01 00 00 00 00 06 F0 55 AA 52 08 05
			39 01 00 00 00 00 06 D1 00 05 00 07 10
			39 01 00 00 00 00 06 D2 00 05 04 07 10
			39 01 00 00 00 00 06 D3 00 00 0A 07 10
			39 01 00 00 00 00 06 D4 00 00 0A 07 10
			39 01 00 00 00 00 06 F0 55 AA 52 08 05
			39 01 00 00 00 00 08 D0 00 00 00 00 00 00 00
			39 01 00 00 00 00 0C D5 00 00 00 00 00 00 00 00 00 00 00
			39 01 00 00 00 00 0C D6 00 00 00 00 00 00 00 00 00 00 00
			39 01 00 00 00 00 0C D7 00 00 00 00 00 00 00 00 00 00 00
			39 01 00 00 00 00 06 D8 00 00 00 00 00
			39 01 00 00 00 00 06 F0 55 AA 52 08 03
			39 01 00 00 00 00 02 C4 60            
			39 01 00 00 00 00 02 C5 40            
			39 01 00 00 00 00 02 C6 60            
			39 01 00 00 00 00 02 C7 40            
			39 01 00 00 00 00 02 6F 01
			39 01 00 00 00 00 02 F9 46
			39 01 00 00 00 00 02 6F 12
			39 01 00 00 00 00 02 F3 80
			39 01 00 00 00 00 02 6F 0C
			39 01 00 00 00 00 05 F3 FF 0F FF FF
			39 01 00 00 00 00 02 6F 12
			39 01 00 00 00 00 02 F3 00
			39 01 00 00 00 00 06 F0 55 AA 52 08 01
			39 01 00 00 00 00 03 BC 78 00         
			39 01 00 00 00 00 03 BD 78 00         
			39 01 00 00 00 00 06 F0 55 AA 52 08 02
			39 01 00 00 00 00 02 EE 01
			39 01 00 00 00 00 11 B0 00 00 00 7A 00 A5 00 C2 00 E0 01 04 01 1B 01 46
			39 01 00 00 00 00 11 B1 01 6A 01 A0 01 CA 02 11 02 4A 02 4B 02 80 02 BD
			39 01 00 00 00 00 11 B2 02 DF 03 0E 03 2B 03 58 03 74 03 99 03 B0 03 E4
			39 01 00 00 00 00 05 B3 03 F8 03 FA
			39 01 00 00 00 00 02 51 1F
			39 01 00 00 00 00 02 53 24
			39 01 00 00 00 00 02 55 00
			05 01 00 00 78 00 02 11 00
			05 01 00 00 20 00 02 29 00];
		qcom,mdss-dsi-off-command = [05 01 00 00 32 00 02 28 00
			05 01 00 00 32 00 02 10 00];

		qcom,mdss-dsi-on-command-state = "dsi_lp_mode";
		qcom,mdss-dsi-off-command-state = "dsi_hs_mode";
		qcom,mdss-dsi-h-sync-pulse = <1>;
		qcom,mdss-dsi-traffic-mode = "burst_mode";
		qcom,mdss-dsi-lane-map = "lane_map_0123";
		qcom,mdss-dsi-hfp-power-mode;
		qcom,mdss-dsi-hbp-power-mode;
		qcom,mdss-dsi-hsa-power-mode;
		qcom,mdss-dsi-bllp-eof-power-mode;
		qcom,mdss-dsi-bllp-power-mode;
		qcom,mdss-dsi-lane-0-state;
		qcom,mdss-dsi-lane-1-state;
		qcom,mdss-dsi-lane-2-state;
		qcom,mdss-dsi-lane-3-state;
		qcom,mdss-dsi-panel-timings = [a8 1f 17 00 2f 2d 1c 21 29 03 04 00];
		qcom,mdss-dsi-t-clk-post = <0x20>;
		qcom,mdss-dsi-t-clk-pre = <0x2f>;
		qcom,mdss-dsi-bl-min-level = <1>;
		qcom,mdss-dsi-bl-max-level = <255>;
		qcom,mdss-dsi-dma-trigger = "trigger_sw";
		qcom,mdss-dsi-mdp-trigger = "none";
		qcom,mdss-dsi-bl-pmic-control-type = "bl_ctrl_dcs";
		qcom,mdss-dsi-reset-sequence = <1 20>, <0 1>, <1 20>;
		qcom,mdss-dsi-lp11-init;
		qcom,mdss-dsi-init-delay-us = <50000>;
	};
};
